## parte_01/aula_01/dts/bindings/pwm/my,pwm-trigger.yaml
```yaml
description: Generic PWM trigger output

compatible: "my,pwm-trigger"

properties:
  pwms:
    type: phandle-array
    required: true
    description: PWM output specifier
```
