## aula_02/dts/bindings/nxp,kinetis-l-spi.yaml
```yaml
# Copyright (c) 2026 Gabriel Ivo <gabriel.bozi@usp.br>
#
# SPDX-License-Identifier: Apache-2.0

description: Custom NXP Kinetis L series SPI Driver for kl25z
compatible: "nxp,kinetis-l-spi"

include: [spi-controller.yaml, pinctrl-device.yaml]

properties:
  cs-gpios:
    type: phandle-array
    description: Pinos GPIO para Chip Select do SPI

  clocks:
    type: phandle-array
    description: Clock do periférico SPI
```

## parte_01/aula_04/dts/bindings/nordic,nrf24l01.yaml
```yaml
description: Nordic NRF24L01+ Wireless Transceiver

compatible: "nordic,nrf24l01"

include: spi-device.yaml

properties:
  ce-gpios:
    type: phandle-array
    required: true
    description: Pin CE (Chip Enable)
  irq-gpios:
    type: phandle-array
    required: false
    description: Pin IRQ
```

## parte_01/aula_05_06/Kconfig
```kconfig
source "Kconfig.zephyr"

mainmenu "Configuracoes da Aplicacao"

config APP_ROLE_TRANSMITTER
    bool "Build as transmitter"
    default n

config APP_TARGET_DISTANCE_CM
    int "Distancia minima para desvio de obstaculo (cm)"
    default 10
    help
      Distancia medida pelo sensor ultrassonico para disparar a manobra de desvio.

config APP_PULSES_PER_TURN
    int "Quantidade de faixas pretas e brancas no disco da roda."
    default 48
    help
        Quantidade de faixas pretas e brancas no disco da roda.

config APP_WHELL_DIAMETER
    int "Diâmetro da roda"
    default 66
    help
        Tamanho do diâmetro da roda.

config APP_WHEELBASE
    int "Distância entre os eixos"
    default 120
    help
        Distância entre os eixos do carrinho.

config APP_DOWNTIME_MS
    int "Tempo em ms que o carrinho fica parado após uma rotação"
    default 200
    help
        Tempo em ms que o carrinho fica parado após uma rotação
        
```
